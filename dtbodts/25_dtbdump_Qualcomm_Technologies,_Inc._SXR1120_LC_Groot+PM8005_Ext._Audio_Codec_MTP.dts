/dts-v1/;

/ {
	compatible = "qcom,sxr1120-mtp\0qcom,sxr1120\0qcom,mtp";
	model = "Qualcomm Technologies, Inc. SXR1120 LC Groot+PM8005 Ext. Audio Codec MTP";
	qcom,board-id = <0x08 0x09>;
	qcom,msm-id = <0x172 0x00>;

	__fixups__ {
		apps_smmu = "/fragment@16/__overlay__/qcom,msm-audio-ion:iommus:0";
		cam_cci = "/fragment@5:target:0";
		cam_sensor_ir_led_off = "/fragment@4/__overlay__/qcom,camera-ir-led@0:pinctrl-1:0";
		cam_sensor_ir_led_on = "/fragment@4/__overlay__/qcom,camera-ir-led@0:pinctrl-0:0";
		cam_sensor_mclk0_active = "/fragment@5/__overlay__/qcom,cam-sensor@0:pinctrl-0:0";
		cam_sensor_mclk0_suspend = "/fragment@5/__overlay__/qcom,cam-sensor@0:pinctrl-1:0";
		cam_sensor_rear_active = "/fragment@5/__overlay__/qcom,cam-sensor@0:pinctrl-0:4";
		cam_sensor_rear_suspend = "/fragment@5/__overlay__/qcom,cam-sensor@0:pinctrl-1:4";
		clock_camcc = "/fragment@5/__overlay__/qcom,cam-sensor@0:clocks:0";
		clock_rpmh = "/fragment@23/__overlay__/audio_ext_clk_lnbb:clocks:0";
		cpe = "/fragment@17/__overlay__/sound-tavil:asoc-platform:44";
		eud = "/fragment@3/__overlay__:extcon:8";
		ext_disp_audio_codec = "/fragment@17/__overlay__/sound-tavil:asoc-codec:4";
		glink_spi_xprt_wdsp = "/fragment@23/__overlay__/qcom,wcd-dsp-mgr:qcom,wdsp-components:16";
		int_codec = "/fragment@25:target:0";
		micbias_supply_en_active = "/fragment@23/__overlay__/msm_cdc_pinctrl@126:pinctrl-0:0";
		micbias_supply_en_sleep = "/fragment@23/__overlay__/msm_cdc_pinctrl@126:pinctrl-1:0";
		pm660_0 = "/fragment@0:target:0";
		pm660_1 = "/fragment@1:target:0";
		pm660_l11 = "/fragment@5/__overlay__/qcom,cam-sensor@0:cam_vio-supply:0";
		pm660_l13 = "/fragment@24/__overlay__/tavil_codec:cdc-vdd-mic-bias-supply:0";
		pm660_l15 = "/fragment@5/__overlay__/qcom,cam-sensor@0:cam_vana-supply:0";
		pm660_l17 = "/fragment@2/__overlay__:vdd-pdphy-supply:0";
		pm660_l18 = "/fragment@11/__overlay__:vdd-io-supply:0";
		pm660_l19 = "/fragment@9/__overlay__:vdd-supply:0";
		pm660_l5 = "/fragment@5/__overlay__/qcom,cam-sensor@0:cam_vdig-supply:0";
		pm660_l8 = "/fragment@9/__overlay__:vdd-io-supply:0";
		pm660_misc = "/fragment@1/__overlay__/qcom,haptics@c000:qcom,pmic-misc:0";
		pm660_pdphy = "/fragment@2:target:0\0/fragment@3/__overlay__:extcon:0\0/fragment@3/__overlay__:extcon:4";
		pm660_revid = "/fragment@0/__overlay__/qcom,qpnp-smb2:qcom,pmic-revid:0\0/fragment@0/__overlay__/rradc@4500:qcom,pmic-revid:0\0/fragment@0/__overlay__/qpnp,fg:qcom,pmic-revid:0\0/fragment@1/__overlay__/qcom,haptics@c000:qcom,pmic-revid:0";
		qupv3_se12_2uart = "/fragment@7:target:0";
		qupv3_se8_spi = "/fragment@8:target:0\0/fragment@22:target:0";
		qupv3_se9_2uart = "/fragment@6:target:0";
		qusb_phy0 = "/fragment@0/__overlay__/qcom,qpnp-smb2:dpdm-supply:0";
		sdc1_clk_off = "/fragment@9/__overlay__:pinctrl-1:0";
		sdc1_clk_on = "/fragment@9/__overlay__:pinctrl-0:0";
		sdc1_cmd_off = "/fragment@9/__overlay__:pinctrl-1:4";
		sdc1_cmd_on = "/fragment@9/__overlay__:pinctrl-0:4";
		sdc1_data_off = "/fragment@9/__overlay__:pinctrl-1:8";
		sdc1_data_on = "/fragment@9/__overlay__:pinctrl-0:8";
		sdc1_rclk_off = "/fragment@9/__overlay__:pinctrl-1:12";
		sdc1_rclk_on = "/fragment@9/__overlay__:pinctrl-0:12";
		sdc2_clk_off = "/fragment@11/__overlay__:pinctrl-1:0";
		sdc2_clk_on = "/fragment@11/__overlay__:pinctrl-0:0";
		sdc2_cmd_off = "/fragment@11/__overlay__:pinctrl-1:4";
		sdc2_cmd_on = "/fragment@11/__overlay__:pinctrl-0:4";
		sdc2_data_off = "/fragment@11/__overlay__:pinctrl-1:8";
		sdc2_data_on = "/fragment@11/__overlay__:pinctrl-0:8";
		sde_dsi_active = "/fragment@12:target:0";
		sde_dsi_suspend = "/fragment@13:target:0";
		sde_te_active = "/fragment@14:target:0";
		sde_te_suspend = "/fragment@15:target:0";
		sdhc_1 = "/fragment@9:target:0";
		sdhc_2 = "/fragment@11:target:0";
		slim_aud = "/fragment@18:target:0\0/fragment@19:target:0\0/fragment@20:target:0\0/fragment@24:target:0";
		soc = "/fragment@4:target:0\0/fragment@16:target:0\0/fragment@17:target:0\0/fragment@21:target:0\0/fragment@23:target:0";
		tasha_spkr_1_sd_n_active = "/fragment@19/__overlay__/tasha_codec/msm_cdc_pinctrll:pinctrl-0:0";
		tasha_spkr_1_sd_n_sleep = "/fragment@19/__overlay__/tasha_codec/msm_cdc_pinctrll:pinctrl-1:0";
		tasha_spkr_2_sd_n_active = "/fragment@19/__overlay__/tasha_codec/msm_cdc_pinctrlr:pinctrl-0:0";
		tasha_spkr_2_sd_n_sleep = "/fragment@19/__overlay__/tasha_codec/msm_cdc_pinctrlr:pinctrl-1:0";
		titan_top_gdsc = "/fragment@5/__overlay__/qcom,cam-sensor@0:cam_clk-supply:0";
		tlmm = "/fragment@4/__overlay__/qcom,camera-ir-led@0:gpios:0\0/fragment@4/__overlay__/qcom,camera-ir-led@0:gpios:12\0/fragment@4/__overlay__/qcom,camera-ir-led@0:gpios:24\0/fragment@4/__overlay__/qcom,camera-ir-led@0:gpios:36\0/fragment@4/__overlay__/qcom,camera-ir-led@0:gpios:48\0/fragment@5/__overlay__/qcom,cam-sensor@0:gpios:0\0/fragment@5/__overlay__/qcom,cam-sensor@0:gpios:12\0/fragment@10:target:0\0/fragment@11/__overlay__:cd-gpios:0\0/fragment@23/__overlay__/wcd9xxx-irq:interrupt-parent:0\0/fragment@23/__overlay__/wcd9xxx-irq:qcom,gpio-connect:0";
		usb0 = "/fragment@3:target:0";
		wcd_intr_default = "/fragment@23/__overlay__/wcd9xxx-irq:pinctrl-0:0";
		wcd_usbc_analog_en1_active = "/fragment@23/__overlay__/msm_cdc_pinctrl_usbc_audio_en1:pinctrl-0:0";
		wcd_usbc_analog_en1_idle = "/fragment@23/__overlay__/msm_cdc_pinctrl_usbc_audio_en1:pinctrl-1:0";
	};

	__local_fixups__ {

		fragment@0 {

			__overlay__ {

				qcom,qpnp-smb2 {
					io-channels = <0x00 0x08 0x10 0x18>;
				};

				qpnp,fg {
					io-channels = <0x00 0x08>;
				};
			};
		};

		fragment@11 {

			__overlay__ {
				pinctrl-0 = <0x0c>;
				pinctrl-1 = <0x0c>;
			};
		};

		fragment@17 {

			__overlay__ {

				sound-tavil {
					asoc-codec = <0x00>;
					asoc-cpu = <0x00 0x04 0x08 0x0c 0x10 0x14 0x18 0x1c 0x20 0x24 0x28 0x2c 0x30 0x34 0x38 0x3c 0x40 0x44 0x48 0x4c 0x50 0x54 0x58 0x5c 0x60 0x64 0x68 0x6c 0x70 0x74 0x78 0x7c 0x80 0x84 0x88 0x8c 0x90 0x94 0x98 0x9c 0xa0 0xa4 0xa8 0xac 0xb0 0xb4 0xb8 0xbc>;
					asoc-platform = <0x00 0x04 0x08 0x0c 0x10 0x14 0x18 0x1c 0x20 0x24 0x28 0x30 0x34>;
					qcom,hph-en0-gpio = <0x00>;
					qcom,hph-en1-gpio = <0x00>;
					qcom,wsa-devs = <0x00 0x04 0x08 0x0c>;
				};
			};
		};

		fragment@19 {

			__overlay__ {

				tavil_codec {

					msm_cdc_pinctrl_hph_en0 {
						pinctrl-0 = <0x00>;
						pinctrl-1 = <0x00>;
					};

					msm_cdc_pinctrl_hph_en1 {
						pinctrl-0 = <0x00>;
						pinctrl-1 = <0x00>;
					};

					msm_cdc_pinctrl_us_euro_sw {
						pinctrl-0 = <0x00>;
						pinctrl-1 = <0x00>;
					};

					msm_cdc_pinctrll {
						pinctrl-0 = <0x00>;
						pinctrl-1 = <0x00>;
					};

					msm_cdc_pinctrlr {
						pinctrl-0 = <0x00>;
						pinctrl-1 = <0x00>;
					};
				};
			};
		};

		fragment@2 {

			__overlay__ {
				vbus-supply = <0x00>;
				vconn-supply = <0x00>;
			};
		};

		fragment@20 {

			__overlay__ {

				tasha_codec {

					swr_master {

						wsa881x@20170211 {
							qcom,spkr-sd-n-node = <0x00>;
						};

						wsa881x@20170212 {
							qcom,spkr-sd-n-node = <0x00>;
						};

						wsa881x@21170213 {
							qcom,spkr-sd-n-node = <0x00>;
						};

						wsa881x@21170214 {
							qcom,spkr-sd-n-node = <0x00>;
						};
					};
				};

				tavil_codec {

					swr_master {

						wsa881x@20170211 {
							qcom,spkr-sd-n-node = <0x00>;
						};

						wsa881x@20170212 {
							qcom,spkr-sd-n-node = <0x00>;
						};

						wsa881x@21170213 {
							qcom,spkr-sd-n-node = <0x00>;
						};

						wsa881x@21170214 {
							qcom,spkr-sd-n-node = <0x00>;
						};
					};
				};
			};
		};

		fragment@23 {

			__overlay__ {

				msm_cdc_pinctrl@64 {
					pinctrl-0 = <0x00>;
					pinctrl-1 = <0x00>;
				};

				qcom,wcd-dsp-mgr {
					qcom,wdsp-components = <0x00 0x08>;
				};
			};
		};

		fragment@24 {

			__overlay__ {

				tavil_codec {
					clocks = <0x00>;
					interrupt-parent = <0x00>;
					qcom,micbias-supply-en-gpio-node = <0x00>;
					qcom,wcd-rst-gpio-node = <0x00>;
				};
			};
		};

		fragment@3 {

			__overlay__ {
				extcon = <0x0c 0x10>;
				vbus_dwc3-supply = <0x00>;
			};
		};

		fragment@5 {

			__overlay__ {

				qcom,cam-sensor@0 {
					ir-led-src = <0x00>;
				};
			};
		};
	};

	__symbols__ {
		afe = "/fragment@16/__overlay__/qcom,msm-pcm-afe";
		afe_loopback_tx = "/fragment@16/__overlay__/qcom,msm-dai-q6/qcom,msm-dai-q6-afe-loopback-tx";
		afe_pcm_rx = "/fragment@16/__overlay__/qcom,msm-dai-q6/qcom,msm-dai-q6-be-afe-pcm-rx";
		afe_pcm_tx = "/fragment@16/__overlay__/qcom,msm-dai-q6/qcom,msm-dai-q6-be-afe-pcm-tx";
		afe_proxy_rx = "/fragment@16/__overlay__/qcom,msm-dai-q6/qcom,msm-dai-q6-afe-proxy-rx";
		afe_proxy_tx = "/fragment@16/__overlay__/qcom,msm-dai-q6/qcom,msm-dai-q6-afe-proxy-tx";
		audio_apr = "/fragment@16/__overlay__/qcom,msm-audio-apr";
		bt_sco_rx = "/fragment@16/__overlay__/qcom,msm-dai-q6/qcom,msm-dai-q6-bt-sco-rx";
		bt_sco_tx = "/fragment@16/__overlay__/qcom,msm-dai-q6/qcom,msm-dai-q6-bt-sco-tx";
		cdc_dmic12_gpios_active = "/fragment@21/__overlay__/lpi_pinctrl@62b40000/dmic12_gpios_active";
		cdc_dmic12_gpios_sleep = "/fragment@21/__overlay__/lpi_pinctrl@62b40000/dmic12_gpios_sleep";
		cdc_dmic34_gpios_active = "/fragment@21/__overlay__/lpi_pinctrl@62b40000/dmic34_gpios_active";
		cdc_dmic34_gpios_sleep = "/fragment@21/__overlay__/lpi_pinctrl@62b40000/dmic34_gpios_sleep";
		cdc_pdm_2_gpios_active = "/fragment@21/__overlay__/lpi_pinctrl@62b40000/cdc_pdm_2_gpios_active";
		cdc_pdm_2_gpios_sleep = "/fragment@21/__overlay__/lpi_pinctrl@62b40000/cdc_pdm_2_gpios_sleep";
		cdc_pdm_clk_active = "/fragment@21/__overlay__/lpi_pinctrl@62b40000/cdc_pdm_clk_active";
		cdc_pdm_clk_sleep = "/fragment@21/__overlay__/lpi_pinctrl@62b40000/cdc_pdm_clk_sleep";
		cdc_pdm_rx0_active = "/fragment@21/__overlay__/lpi_pinctrl@62b40000/cdc_pdm_rx0_active";
		cdc_pdm_rx0_sleep = "/fragment@21/__overlay__/lpi_pinctrl@62b40000/cdc_pdm_rx0_sleep";
		cdc_pdm_rx1_2_active = "/fragment@21/__overlay__/lpi_pinctrl@62b40000/cdc_pdm_rx1_2_active";
		cdc_pdm_rx1_2_sleep = "/fragment@21/__overlay__/lpi_pinctrl@62b40000/cdc_pdm_rx1_2_sleep";
		cdc_pdm_sync_active = "/fragment@21/__overlay__/lpi_pinctrl@62b40000/cdc_pdm_sync_active";
		cdc_pdm_sync_sleep = "/fragment@21/__overlay__/lpi_pinctrl@62b40000/cdc_pdm_sync_sleep";
		cdc_rx0_comp_active = "/fragment@21/__overlay__/lpi_pinctrl@62b40000/cdc_pdm_rx0_comp_active";
		cdc_rx0_comp_sleep = "/fragment@21/__overlay__/lpi_pinctrl@62b40000/cdc_pdm_rx0_comp_sleep";
		cdc_rx1_comp_active = "/fragment@21/__overlay__/lpi_pinctrl@62b40000/cdc_pdm_rx1_comp_active";
		cdc_rx1_comp_sleep = "/fragment@21/__overlay__/lpi_pinctrl@62b40000/cdc_pdm_rx1_comp_sleep";
		clock_audio_lnbb = "/fragment@23/__overlay__/audio_ext_clk_lnbb";
		compr = "/fragment@16/__overlay__/qcom,msm-compr-dsp";
		compress = "/fragment@16/__overlay__/qcom,msm-compress-dsp";
		dai_dp = "/fragment@16/__overlay__/qcom,msm-dai-q6-dp";
		dai_hdmi = "/fragment@16/__overlay__/qcom,msm-dai-q6-hdmi";
		dai_int_mi2s0 = "/fragment@16/__overlay__/qcom,msm-dai-mi2s/qcom,msm-dai-q6-int-mi2s0";
		dai_int_mi2s1 = "/fragment@16/__overlay__/qcom,msm-dai-mi2s/qcom,msm-dai-q6-int-mi2s1";
		dai_int_mi2s2 = "/fragment@16/__overlay__/qcom,msm-dai-mi2s/qcom,msm-dai-q6-int-mi2s2";
		dai_int_mi2s3 = "/fragment@16/__overlay__/qcom,msm-dai-mi2s/qcom,msm-dai-q6-int-mi2s3";
		dai_int_mi2s4 = "/fragment@16/__overlay__/qcom,msm-dai-mi2s/qcom,msm-dai-q6-int-mi2s4";
		dai_int_mi2s5 = "/fragment@16/__overlay__/qcom,msm-dai-mi2s/qcom,msm-dai-q6-int-mi2s5";
		dai_int_mi2s6 = "/fragment@16/__overlay__/qcom,msm-dai-mi2s/qcom,msm-dai-q6-int-mi2s6";
		dai_mi2s0 = "/fragment@16/__overlay__/qcom,msm-dai-mi2s/qcom,msm-dai-q6-mi2s-prim";
		dai_mi2s1 = "/fragment@16/__overlay__/qcom,msm-dai-mi2s/qcom,msm-dai-q6-mi2s-sec";
		dai_mi2s2 = "/fragment@16/__overlay__/qcom,msm-dai-mi2s/qcom,msm-dai-q6-mi2s-tert";
		dai_mi2s3 = "/fragment@16/__overlay__/qcom,msm-dai-mi2s/qcom,msm-dai-q6-mi2s-quat";
		dai_mi2s4 = "/fragment@16/__overlay__/qcom,msm-dai-mi2s/qcom,msm-dai-q6-mi2s-quin";
		dai_mi2s5 = "/fragment@16/__overlay__/qcom,msm-dai-mi2s/qcom,msm-dai-q6-mi2s-senary";
		dai_pri_auxpcm = "/fragment@16/__overlay__/qcom,msm-pri-auxpcm";
		dai_pri_tdm_rx_0 = "/fragment@16/__overlay__/qcom,msm-dai-tdm-pri-rx/qcom,msm-dai-q6-tdm-pri-rx-0";
		dai_pri_tdm_tx_0 = "/fragment@16/__overlay__/qcom,msm-dai-tdm-pri-tx/qcom,msm-dai-q6-tdm-pri-tx-0";
		dai_quat_auxpcm = "/fragment@16/__overlay__/qcom,msm-quat-auxpcm";
		dai_quat_tdm_rx_0 = "/fragment@16/__overlay__/qcom,msm-dai-tdm-quat-rx/qcom,msm-dai-q6-tdm-quat-rx-0";
		dai_quat_tdm_tx_0 = "/fragment@16/__overlay__/qcom,msm-dai-tdm-quat-tx/qcom,msm-dai-q6-tdm-quat-tx-0";
		dai_quin_auxpcm = "/fragment@16/__overlay__/qcom,msm-quin-auxpcm";
		dai_quin_tdm_rx_0 = "/fragment@16/__overlay__/qcom,msm-dai-tdm-quin-rx/qcom,msm-dai-q6-tdm-quin-rx-0";
		dai_quin_tdm_tx_0 = "/fragment@16/__overlay__/qcom,msm-dai-tdm-quin-tx/qcom,msm-dai-q6-tdm-quin-tx-0";
		dai_sec_auxpcm = "/fragment@16/__overlay__/qcom,msm-sec-auxpcm";
		dai_sec_tdm_rx_0 = "/fragment@16/__overlay__/qcom,msm-dai-tdm-sec-rx/qcom,msm-dai-q6-tdm-sec-rx-0";
		dai_sec_tdm_tx_0 = "/fragment@16/__overlay__/qcom,msm-dai-tdm-sec-tx/qcom,msm-dai-q6-tdm-sec-tx-0";
		dai_slim = "/fragment@18/__overlay__/msm_dai_slim";
		dai_tert_auxpcm = "/fragment@16/__overlay__/qcom,msm-tert-auxpcm";
		dai_tert_tdm_rx_0 = "/fragment@16/__overlay__/qcom,msm-dai-tdm-tert-rx/qcom,msm-dai-q6-tdm-tert-rx-0";
		dai_tert_tdm_tx_0 = "/fragment@16/__overlay__/qcom,msm-dai-tdm-tert-tx/qcom,msm-dai-q6-tdm-tert-tx-0";
		hdmi_dba = "/fragment@16/__overlay__/qcom,msm-hdmi-dba-codec-rx";
		hostless = "/fragment@16/__overlay__/qcom,msm-pcm-hostless";
		hph_en0_wcd_active = "/fragment@19/__overlay__/tavil_codec/wcd_pinctrl@5/hph_en0_wcd_active";
		hph_en0_wcd_sleep = "/fragment@19/__overlay__/tavil_codec/wcd_pinctrl@5/hph_en0_wcd_sleep";
		hph_en1_wcd_active = "/fragment@19/__overlay__/tavil_codec/wcd_pinctrl@5/hph_en1_wcd_active";
		hph_en1_wcd_sleep = "/fragment@19/__overlay__/tavil_codec/wcd_pinctrl@5/hph_en1_wcd_sleep";
		incall_music_2_rx = "/fragment@16/__overlay__/qcom,msm-dai-q6/qcom,msm-dai-q6-incall-music-2-rx";
		incall_music_rx = "/fragment@16/__overlay__/qcom,msm-dai-q6/qcom,msm-dai-q6-incall-music-rx";
		incall_record_rx = "/fragment@16/__overlay__/qcom,msm-dai-q6/qcom,msm-dai-q6-incall-record-rx";
		incall_record_tx = "/fragment@16/__overlay__/qcom,msm-dai-q6/qcom,msm-dai-q6-incall-record-tx";
		int_fm_rx = "/fragment@16/__overlay__/qcom,msm-dai-q6/qcom,msm-dai-q6-int-fm-rx";
		int_fm_tx = "/fragment@16/__overlay__/qcom,msm-dai-q6/qcom,msm-dai-q6-int-fm-tx";
		ir_led = "/fragment@4/__overlay__/qcom,camera-ir-led@0";
		loopback = "/fragment@16/__overlay__/qcom,msm-pcm-loopback";
		lpi_cdc_reset_active = "/fragment@21/__overlay__/lpi_pinctrl@62b40000/lpi_cdc_reset_active";
		lpi_cdc_reset_sleep = "/fragment@21/__overlay__/lpi_pinctrl@62b40000/lpi_cdc_reset_sleep";
		lpi_mclk0_active = "/fragment@21/__overlay__/lpi_pinctrl@62b40000/lpi_mclk0_active";
		lpi_mclk0_sleep = "/fragment@21/__overlay__/lpi_pinctrl@62b40000/lpi_mclk0_sleep";
		lpi_tlmm = "/fragment@21/__overlay__/lpi_pinctrl@62b40000";
		lsm = "/fragment@16/__overlay__/qcom,msm-lsm-client";
		micbias_supply_en_gpio = "/fragment@23/__overlay__/msm_cdc_pinctrl@126";
		msm_audio_ion = "/fragment@16/__overlay__/qcom,msm-audio-ion";
		msm_dai_mi2s = "/fragment@16/__overlay__/qcom,msm-dai-mi2s";
		msm_dai_tdm_quat_rx = "/fragment@16/__overlay__/qcom,msm-dai-tdm-quat-rx";
		pcm0 = "/fragment@16/__overlay__/qcom,msm-pcm";
		pcm1 = "/fragment@16/__overlay__/qcom,msm-pcm-low-latency";
		pcm2 = "/fragment@16/__overlay__/qcom,msm-ultra-low-latency";
		pcm_noirq = "/fragment@16/__overlay__/qcom,msm-pcm-dsp-noirq";
		pm660_charger = "/fragment@0/__overlay__/qcom,qpnp-smb2";
		pm660_fg = "/fragment@0/__overlay__/qpnp,fg";
		pm660_haptics = "/fragment@1/__overlay__/qcom,haptics@c000";
		pm660_rradc = "/fragment@0/__overlay__/rradc@4500";
		routing = "/fragment@16/__overlay__/qcom,msm-pcm-routing";
		sb_0_rx = "/fragment@16/__overlay__/qcom,msm-dai-q6/qcom,msm-dai-q6-sb-0-rx";
		sb_0_tx = "/fragment@16/__overlay__/qcom,msm-dai-q6/qcom,msm-dai-q6-sb-0-tx";
		sb_1_rx = "/fragment@16/__overlay__/qcom,msm-dai-q6/qcom,msm-dai-q6-sb-1-rx";
		sb_1_tx = "/fragment@16/__overlay__/qcom,msm-dai-q6/qcom,msm-dai-q6-sb-1-tx";
		sb_2_rx = "/fragment@16/__overlay__/qcom,msm-dai-q6/qcom,msm-dai-q6-sb-2-rx";
		sb_2_tx = "/fragment@16/__overlay__/qcom,msm-dai-q6/qcom,msm-dai-q6-sb-2-tx";
		sb_3_rx = "/fragment@16/__overlay__/qcom,msm-dai-q6/qcom,msm-dai-q6-sb-3-rx";
		sb_3_tx = "/fragment@16/__overlay__/qcom,msm-dai-q6/qcom,msm-dai-q6-sb-3-tx";
		sb_4_rx = "/fragment@16/__overlay__/qcom,msm-dai-q6/qcom,msm-dai-q6-sb-4-rx";
		sb_4_tx = "/fragment@16/__overlay__/qcom,msm-dai-q6/qcom,msm-dai-q6-sb-4-tx";
		sb_5_rx = "/fragment@16/__overlay__/qcom,msm-dai-q6/qcom,msm-dai-q6-sb-5-rx";
		sb_5_tx = "/fragment@16/__overlay__/qcom,msm-dai-q6/qcom,msm-dai-q6-sb-5-tx";
		sb_6_rx = "/fragment@16/__overlay__/qcom,msm-dai-q6/qcom,msm-dai-q6-sb-6-rx";
		sb_7_rx = "/fragment@16/__overlay__/qcom,msm-dai-q6/qcom,msm-dai-q6-sb-7-rx";
		sb_7_tx = "/fragment@16/__overlay__/qcom,msm-dai-q6/qcom,msm-dai-q6-sb-7-tx";
		sb_8_rx = "/fragment@16/__overlay__/qcom,msm-dai-q6/qcom,msm-dai-q6-sb-8-rx";
		sb_8_tx = "/fragment@16/__overlay__/qcom,msm-dai-q6/qcom,msm-dai-q6-sb-8-tx";
		sdc2_cd_off = "/fragment@10/__overlay__/cd_off";
		sdc2_cd_on = "/fragment@10/__overlay__/cd_on";
		smb2_vbus = "/fragment@0/__overlay__/qcom,qpnp-smb2/qcom,smb2-vbus";
		smb2_vconn = "/fragment@0/__overlay__/qcom,qpnp-smb2/qcom,smb2-vconn";
		spkr_1_wcd_en_active = "/fragment@19/__overlay__/tavil_codec/wcd_pinctrl@5/spkr_1_wcd_en_active";
		spkr_1_wcd_en_sleep = "/fragment@19/__overlay__/tavil_codec/wcd_pinctrl@5/spkr_1_wcd_en_sleep";
		spkr_2_wcd_en_active = "/fragment@19/__overlay__/tavil_codec/wcd_pinctrl@5/spkr_2_sd_n_active";
		spkr_2_wcd_en_sleep = "/fragment@19/__overlay__/tavil_codec/wcd_pinctrl@5/spkr_2_sd_n_sleep";
		stub_codec = "/fragment@16/__overlay__/qcom,msm-stub-codec";
		tavil_hph_en0 = "/fragment@19/__overlay__/tavil_codec/msm_cdc_pinctrl_hph_en0";
		tavil_hph_en1 = "/fragment@19/__overlay__/tavil_codec/msm_cdc_pinctrl_hph_en1";
		tavil_snd = "/fragment@17/__overlay__/sound-tavil";
		tavil_us_euro_sw = "/fragment@19/__overlay__/tavil_codec/msm_cdc_pinctrl_us_euro_sw";
		us_euro_sw_wcd_active = "/fragment@19/__overlay__/tavil_codec/wcd_pinctrl@5/us_euro_sw_wcd_active";
		us_euro_sw_wcd_sleep = "/fragment@19/__overlay__/tavil_codec/wcd_pinctrl@5/us_euro_sw_wcd_sleep";
		usb_audio_rx = "/fragment@16/__overlay__/qcom,msm-dai-q6/qcom,msm-dai-q6-usb-audio-rx";
		usb_audio_tx = "/fragment@16/__overlay__/qcom,msm-dai-q6/qcom,msm-dai-q6-usb-audio-tx";
		voice = "/fragment@16/__overlay__/qcom,msm-pcm-voice";
		voip = "/fragment@16/__overlay__/qcom,msm-voip-dsp";
		wcd = "/fragment@19/__overlay__/tavil_codec/wcd_pinctrl@5";
		wcd934x_cdc = "/fragment@24/__overlay__/tavil_codec";
		wcd9xxx_intc = "/fragment@23/__overlay__/wcd9xxx-irq";
		wcd_rst_gpio = "/fragment@23/__overlay__/msm_cdc_pinctrl@64";
		wcd_spi_0 = "/fragment@24/__overlay__/tavil_codec/wcd_spi";
		wcd_usbc_analog_en1_gpio = "/fragment@23/__overlay__/msm_cdc_pinctrl_usbc_audio_en1";
		wdsp_glink = "/fragment@23/__overlay__/qcom,wcd-dsp-glink";
		wdsp_mgr = "/fragment@23/__overlay__/qcom,wcd-dsp-mgr";
		wsa881x_0211 = "/fragment@20/__overlay__/tavil_codec/swr_master/wsa881x@20170211";
		wsa881x_0212 = "/fragment@20/__overlay__/tavil_codec/swr_master/wsa881x@20170212";
		wsa881x_0213 = "/fragment@20/__overlay__/tavil_codec/swr_master/wsa881x@21170213";
		wsa881x_0214 = "/fragment@20/__overlay__/tavil_codec/swr_master/wsa881x@21170214";
		wsa881x_211 = "/fragment@20/__overlay__/tasha_codec/swr_master/wsa881x@20170211";
		wsa881x_212 = "/fragment@20/__overlay__/tasha_codec/swr_master/wsa881x@20170212";
		wsa881x_213 = "/fragment@20/__overlay__/tasha_codec/swr_master/wsa881x@21170213";
		wsa881x_214 = "/fragment@20/__overlay__/tasha_codec/swr_master/wsa881x@21170214";
		wsa_spkr_sd1 = "/fragment@19/__overlay__/tasha_codec/msm_cdc_pinctrll";
		wsa_spkr_sd2 = "/fragment@19/__overlay__/tasha_codec/msm_cdc_pinctrlr";
		wsa_spkr_wcd_sd1 = "/fragment@19/__overlay__/tavil_codec/msm_cdc_pinctrll";
		wsa_spkr_wcd_sd2 = "/fragment@19/__overlay__/tavil_codec/msm_cdc_pinctrlr";
	};

	fragment@0 {
		target = <0xffffffff>;

		__overlay__ {

			qcom,qpnp-smb2 {
				#address-cells = <0x01>;
				#cooling-cells = <0x02>;
				#size-cells = <0x01>;
				compatible = "qcom,qpnp-smb2";
				dpdm-supply = <0xffffffff>;
				io-channel-names = "charger_temp\0charger_temp_max\0usbin_i\0usbin_v";
				io-channels = <0x01 0x08 0x01 0x0a 0x01 0x03 0x01 0x04>;
				phandle = <0x04>;
				qcom,auto-recharge-soc;
				qcom,pmic-revid = <0xffffffff>;
				qcom,qcs605-ipc-wa;
				qcom,thermal-mitigation = <0x2dc6c0 0x2625a0 0x1e8480 0x16e360 0xf4240 0x7a120>;
				qcom,wipower-max-uw = <0x4c4b40>;

				qcom,bat-if@1200 {
					interrupt-names = "bat-temp\0bat-ocp\0bat-ov\0bat-low\0bat-therm-or-id-missing\0bat-terminal-missing";
					interrupts = <0x00 0x12 0x00 0x01 0x00 0x12 0x01 0x03 0x00 0x12 0x02 0x03 0x00 0x12 0x03 0x03 0x00 0x12 0x04 0x03 0x00 0x12 0x05 0x03>;
					reg = <0x1200 0x100>;
				};

				qcom,chgr-misc@1600 {
					interrupt-names = "wdog-snarl\0wdog-bark\0aicl-fail\0aicl-done\0high-duty-cycle\0input-current-limiting\0temperature-change\0switcher-power-ok";
					interrupts = <0x00 0x16 0x00 0x01 0x00 0x16 0x01 0x01 0x00 0x16 0x02 0x03 0x00 0x16 0x03 0x03 0x00 0x16 0x04 0x03 0x00 0x16 0x05 0x03 0x00 0x16 0x06 0x02 0x00 0x16 0x07 0x03>;
					reg = <0x1600 0x100>;
				};

				qcom,chgr@1000 {
					interrupt-names = "chg-error\0chg-state-change\0step-chg-state-change\0step-chg-soc-update-fail\0step-chg-soc-update-request";
					interrupts = <0x00 0x10 0x00 0x01 0x00 0x10 0x01 0x01 0x00 0x10 0x02 0x01 0x00 0x10 0x03 0x01 0x00 0x10 0x04 0x01>;
					reg = <0x1000 0x100>;
				};

				qcom,dc-chgpth@1400 {
					interrupt-names = "dcin-collapse\0dcin-lt-3p6v\0dcin-uv\0dcin-ov\0dcin-plugin\0div2-en-dg\0dcin-icl-change";
					interrupts = <0x00 0x14 0x00 0x03 0x00 0x14 0x01 0x03 0x00 0x14 0x02 0x03 0x00 0x14 0x03 0x03 0x00 0x14 0x04 0x03 0x00 0x14 0x05 0x03 0x00 0x14 0x06 0x01>;
					reg = <0x1400 0x100>;
				};

				qcom,otg@1100 {
					interrupt-names = "otg-fail\0otg-overcurrent\0otg-oc-dis-sw-sts\0testmode-change-detect";
					interrupts = <0x00 0x11 0x00 0x03 0x00 0x11 0x01 0x03 0x00 0x11 0x02 0x03 0x00 0x11 0x03 0x03>;
					reg = <0x1100 0x100>;
				};

				qcom,smb2-vbus {
					phandle = <0x02>;
					regulator-name = "smb2-vbus";
				};

				qcom,smb2-vconn {
					phandle = <0x03>;
					regulator-name = "smb2-vconn";
				};

				qcom,usb-chgpth@1300 {
					interrupt-names = "usbin-collapse\0usbin-lt-3p6v\0usbin-uv\0usbin-ov\0usbin-plugin\0usbin-src-change\0usbin-icl-change\0type-c-change";
					interrupts = <0x00 0x13 0x00 0x03 0x00 0x13 0x01 0x03 0x00 0x13 0x02 0x03 0x00 0x13 0x03 0x03 0x00 0x13 0x04 0x03 0x00 0x13 0x05 0x01 0x00 0x13 0x06 0x01 0x00 0x13 0x07 0x01>;
					reg = <0x1300 0x100>;
				};
			};

			qpnp,fg {
				#address-cells = <0x01>;
				#size-cells = <0x01>;
				compatible = "qcom,fg-gen3";
				io-channel-names = "rradc_batt_id\0rradc_die_temp";
				io-channels = <0x01 0x00 0x01 0x07>;
				phandle = <0x62>;
				qcom,cycle-counter-en;
				qcom,fg-auto-recharge-soc;
				qcom,fg-esr-timer-asleep = <0xe0 0x100>;
				qcom,fg-esr-timer-awake = <0x40 0x60>;
				qcom,fg-esr-timer-charging = <0x00 0x60>;
				qcom,fg-recharge-soc-thr = <0x62>;
				qcom,hold-soc-while-full;
				qcom,pmic-revid = <0xffffffff>;
				qcom,rradc-base = <0x4500>;
				status = "okay";

				qcom,fg-batt-info@4100 {
					interrupt-names = "vbatt-pred-delta\0vbatt-low\0esr-delta\0batt-missing\0batt-temp-delta";
					interrupts = <0x00 0x41 0x00 0x03 0x00 0x41 0x01 0x03 0x00 0x41 0x02 0x03 0x00 0x41 0x03 0x03 0x00 0x41 0x06 0x03>;
					reg = <0x4100 0x100>;
					status = "okay";
				};

				qcom,fg-batt-soc@4000 {
					interrupt-names = "soc-update\0soc-ready\0bsoc-delta\0msoc-delta\0msoc-low\0msoc-empty\0msoc-high\0msoc-full";
					interrupts = <0x00 0x40 0x00 0x03 0x00 0x40 0x01 0x03 0x00 0x40 0x02 0x01 0x00 0x40 0x03 0x01 0x00 0x40 0x04 0x03 0x00 0x40 0x05 0x01 0x00 0x40 0x06 0x03 0x00 0x40 0x07 0x03>;
					reg = <0x4000 0x100>;
					status = "okay";
				};

				qcom,fg-memif@4400 {
					interrupt-names = "ima-rdy\0mem-xcp\0dma-grant";
					interrupts = <0x00 0x44 0x00 0x03 0x00 0x44 0x01 0x03 0x00 0x44 0x02 0x03>;
					reg = <0x4400 0x100>;
					status = "okay";
				};
			};

			rradc@4500 {
				#address-cells = <0x01>;
				#io-channel-cells = <0x01>;
				#size-cells = <0x00>;
				compatible = "qcom,rradc";
				phandle = <0x01>;
				qcom,pmic-revid = <0xffffffff>;
				reg = <0x4500 0x100>;
			};
		};
	};

	fragment@1 {
		target = <0xffffffff>;

		__overlay__ {

			qcom,haptics@c000 {
				compatible = "qcom,qpnp-haptics";
				interrupt-names = "hap-sc-irq\0hap-play-irq";
				interrupts = <0x01 0xc0 0x00 0x03 0x01 0xc0 0x01 0x03>;
				phandle = <0x63>;
				qcom,actuator-type = <0x00>;
				qcom,en-brake;
				qcom,ilim-ma = <0x320>;
				qcom,lra-auto-res-mode = "qwd";
				qcom,lra-high-z = "opt0";
				qcom,lra-res-cal-period = <0x04>;
				qcom,misc-clk-trim-error-reg = <0xf3>;
				qcom,play-mode = "direct";
				qcom,pmic-misc = <0xffffffff>;
				qcom,pmic-revid = <0xffffffff>;
				qcom,sc-dbc-cycles = <0x08>;
				qcom,vmax-mv = <0xc80>;
				qcom,wave-play-rate-us = <0x1a0b>;
				reg = <0xc000 0x100>;
			};
		};
	};

	fragment@10 {
		target = <0xffffffff>;

		__overlay__ {

			cd_off {
				phandle = <0x07>;

				config {
					bias-disable;
					drive-strength = <0x02>;
					pins = "gpio116";
				};

				mux {
					function = "gpio";
					pins = "gpio116";
				};
			};

			cd_on {
				phandle = <0x06>;

				config {
					bias-pull-up;
					drive-strength = <0x02>;
					pins = "gpio116";
				};

				mux {
					function = "gpio";
					pins = "gpio116";
				};
			};
		};
	};

	fragment@11 {
		target = <0xffffffff>;

		__overlay__ {
			cd-gpios = <0xffffffff 0x74 0x01>;
			pinctrl-0 = <0xffffffff 0xffffffff 0xffffffff 0x06>;
			pinctrl-1 = <0xffffffff 0xffffffff 0xffffffff 0x07>;
			pinctrl-names = "active\0sleep";
			qcom,vdd-io-current-level = <0x00 0x55f0>;
			qcom,vdd-io-voltage-level = <0x1b7740 0x2d2a80>;
			status = "ok";
			vdd-io-supply = <0xffffffff>;
		};
	};

	fragment@12 {
		target = <0xffffffff>;

		__overlay__ {
			pins = "gpio93\0gpio121\0gpio76";
		};
	};

	fragment@13 {
		target = <0xffffffff>;

		__overlay__ {
			pins = "gpio93\0gpio121\0gpio76";
		};
	};

	fragment@14 {
		target = <0xffffffff>;

		__overlay__ {
			pins = "gpio10";
		};
	};

	fragment@15 {
		target = <0xffffffff>;

		__overlay__ {
			pins = "gpio10";
		};
	};

	fragment@16 {
		target = <0xffffffff>;

		__overlay__ {

			qcom,msm-adsp-loader {
				adsp-firmware = "adsp_v2";
				compatible = "qcom,adsp-loader";
				qcom,adsp-state = <0x00>;
				status = "ok";
			};

			qcom,msm-audio-apr {
				compatible = "qcom,msm-audio-apr";
				phandle = <0x73>;
				qcom,subsys-name = "apr_adsp";
			};

			qcom,msm-audio-ion {
				compatible = "qcom,msm-audio-ion";
				iommus = <0xffffffff 0x1801 0x00>;
				phandle = <0x75>;
				qcom,smmu-enabled;
				qcom,smmu-sid-mask = <0x00 0x0f>;
				qcom,smmu-version = <0x02>;
			};

			qcom,msm-compr-dsp {
				compatible = "qcom,msm-compr-dsp";
				phandle = <0x13>;
			};

			qcom,msm-compress-dsp {
				compatible = "qcom,msm-compress-dsp";
				phandle = <0x0e>;
			};

			qcom,msm-dai-fe {
				compatible = "qcom,msm-dai-fe";
			};

			qcom,msm-dai-mi2s {
				compatible = "qcom,msm-dai-mi2s";
				phandle = <0x65>;

				qcom,msm-dai-q6-int-mi2s0 {
					compatible = "qcom,msm-dai-q6-mi2s";
					phandle = <0x67>;
					qcom,msm-dai-q6-mi2s-dev-id = <0x07>;
					qcom,msm-mi2s-rx-lines = <0x03>;
					qcom,msm-mi2s-tx-lines = <0x00>;
				};

				qcom,msm-dai-q6-int-mi2s1 {
					compatible = "qcom,msm-dai-q6-mi2s";
					phandle = <0x68>;
					qcom,msm-dai-q6-mi2s-dev-id = <0x08>;
					qcom,msm-mi2s-rx-lines = <0x03>;
					qcom,msm-mi2s-tx-lines = <0x00>;
				};

				qcom,msm-dai-q6-int-mi2s2 {
					compatible = "qcom,msm-dai-q6-mi2s";
					phandle = <0x69>;
					qcom,msm-dai-q6-mi2s-dev-id = <0x09>;
					qcom,msm-mi2s-rx-lines = <0x00>;
					qcom,msm-mi2s-tx-lines = <0x03>;
				};

				qcom,msm-dai-q6-int-mi2s3 {
					compatible = "qcom,msm-dai-q6-mi2s";
					phandle = <0x6a>;
					qcom,msm-dai-q6-mi2s-dev-id = <0x0a>;
					qcom,msm-mi2s-rx-lines = <0x00>;
					qcom,msm-mi2s-tx-lines = <0x03>;
				};

				qcom,msm-dai-q6-int-mi2s4 {
					compatible = "qcom,msm-dai-q6-mi2s";
					phandle = <0x6b>;
					qcom,msm-dai-q6-mi2s-dev-id = <0x0b>;
					qcom,msm-mi2s-rx-lines = <0x03>;
					qcom,msm-mi2s-tx-lines = <0x00>;
				};

				qcom,msm-dai-q6-int-mi2s5 {
					compatible = "qcom,msm-dai-q6-mi2s";
					phandle = <0x6c>;
					qcom,msm-dai-q6-mi2s-dev-id = <0x0c>;
					qcom,msm-mi2s-rx-lines = <0x00>;
					qcom,msm-mi2s-tx-lines = <0x03>;
				};

				qcom,msm-dai-q6-int-mi2s6 {
					compatible = "qcom,msm-dai-q6-mi2s";
					phandle = <0x6d>;
					qcom,msm-dai-q6-mi2s-dev-id = <0x0d>;
					qcom,msm-mi2s-rx-lines = <0x00>;
					qcom,msm-mi2s-tx-lines = <0x03>;
				};

				qcom,msm-dai-q6-mi2s-prim {
					compatible = "qcom,msm-dai-q6-mi2s";
					phandle = <0x16>;
					qcom,msm-dai-q6-mi2s-dev-id = <0x00>;
					qcom,msm-mi2s-rx-lines = <0x03>;
					qcom,msm-mi2s-tx-lines = <0x00>;
				};

				qcom,msm-dai-q6-mi2s-quat {
					compatible = "qcom,msm-dai-q6-mi2s";
					phandle = <0x19>;
					qcom,msm-dai-q6-mi2s-dev-id = <0x03>;
					qcom,msm-mi2s-rx-lines = <0x01>;
					qcom,msm-mi2s-tx-lines = <0x02>;
				};

				qcom,msm-dai-q6-mi2s-quin {
					compatible = "qcom,msm-dai-q6-mi2s";
					phandle = <0x1a>;
					qcom,msm-dai-q6-mi2s-dev-id = <0x04>;
					qcom,msm-mi2s-rx-lines = <0x01>;
					qcom,msm-mi2s-tx-lines = <0x02>;
				};

				qcom,msm-dai-q6-mi2s-sec {
					compatible = "qcom,msm-dai-q6-mi2s";
					phandle = <0x17>;
					qcom,msm-dai-q6-mi2s-dev-id = <0x01>;
					qcom,msm-mi2s-rx-lines = <0x01>;
					qcom,msm-mi2s-tx-lines = <0x00>;
				};

				qcom,msm-dai-q6-mi2s-senary {
					compatible = "qcom,msm-dai-q6-mi2s";
					phandle = <0x66>;
					qcom,msm-dai-q6-mi2s-dev-id = <0x06>;
					qcom,msm-mi2s-rx-lines = <0x00>;
					qcom,msm-mi2s-tx-lines = <0x03>;
				};

				qcom,msm-dai-q6-mi2s-tert {
					compatible = "qcom,msm-dai-q6-mi2s";
					phandle = <0x18>;
					qcom,msm-dai-q6-mi2s-dev-id = <0x02>;
					qcom,msm-mi2s-rx-lines = <0x00>;
					qcom,msm-mi2s-tx-lines = <0x03>;
				};
			};

			qcom,msm-dai-q6 {
				compatible = "qcom,msm-dai-q6";

				qcom,msm-dai-q6-afe-loopback-tx {
					compatible = "qcom,msm-dai-q6-dev";
					phandle = <0x72>;
					qcom,msm-dai-q6-dev-id = <0x6001>;
				};

				qcom,msm-dai-q6-afe-proxy-rx {
					compatible = "qcom,msm-dai-q6-dev";
					phandle = <0x33>;
					qcom,msm-dai-q6-dev-id = <0xf1>;
				};

				qcom,msm-dai-q6-afe-proxy-tx {
					compatible = "qcom,msm-dai-q6-dev";
					phandle = <0x34>;
					qcom,msm-dai-q6-dev-id = <0xf0>;
				};

				qcom,msm-dai-q6-be-afe-pcm-rx {
					compatible = "qcom,msm-dai-q6-dev";
					phandle = <0x31>;
					qcom,msm-dai-q6-dev-id = <0xe0>;
				};

				qcom,msm-dai-q6-be-afe-pcm-tx {
					compatible = "qcom,msm-dai-q6-dev";
					phandle = <0x32>;
					qcom,msm-dai-q6-dev-id = <0xe1>;
				};

				qcom,msm-dai-q6-bt-sco-rx {
					compatible = "qcom,msm-dai-q6-dev";
					phandle = <0x6e>;
					qcom,msm-dai-q6-dev-id = <0x3000>;
				};

				qcom,msm-dai-q6-bt-sco-tx {
					compatible = "qcom,msm-dai-q6-dev";
					phandle = <0x6f>;
					qcom,msm-dai-q6-dev-id = <0x3001>;
				};

				qcom,msm-dai-q6-incall-music-2-rx {
					compatible = "qcom,msm-dai-q6-dev";
					phandle = <0x38>;
					qcom,msm-dai-q6-dev-id = <0x8002>;
				};

				qcom,msm-dai-q6-incall-music-rx {
					compatible = "qcom,msm-dai-q6-dev";
					phandle = <0x37>;
					qcom,msm-dai-q6-dev-id = <0x8005>;
				};

				qcom,msm-dai-q6-incall-record-rx {
					compatible = "qcom,msm-dai-q6-dev";
					phandle = <0x35>;
					qcom,msm-dai-q6-dev-id = <0x8003>;
				};

				qcom,msm-dai-q6-incall-record-tx {
					compatible = "qcom,msm-dai-q6-dev";
					phandle = <0x36>;
					qcom,msm-dai-q6-dev-id = <0x8004>;
				};

				qcom,msm-dai-q6-int-fm-rx {
					compatible = "qcom,msm-dai-q6-dev";
					phandle = <0x70>;
					qcom,msm-dai-q6-dev-id = <0x3004>;
				};

				qcom,msm-dai-q6-int-fm-tx {
					compatible = "qcom,msm-dai-q6-dev";
					phandle = <0x71>;
					qcom,msm-dai-q6-dev-id = <0x3005>;
				};

				qcom,msm-dai-q6-sb-0-rx {
					compatible = "qcom,msm-dai-q6-dev";
					phandle = <0x20>;
					qcom,msm-dai-q6-dev-id = <0x4000>;
				};

				qcom,msm-dai-q6-sb-0-tx {
					compatible = "qcom,msm-dai-q6-dev";
					phandle = <0x21>;
					qcom,msm-dai-q6-dev-id = <0x4001>;
				};

				qcom,msm-dai-q6-sb-1-rx {
					compatible = "qcom,msm-dai-q6-dev";
					phandle = <0x22>;
					qcom,msm-dai-q6-dev-id = <0x4002>;
				};

				qcom,msm-dai-q6-sb-1-tx {
					compatible = "qcom,msm-dai-q6-dev";
					phandle = <0x23>;
					qcom,msm-dai-q6-dev-id = <0x4003>;
				};

				qcom,msm-dai-q6-sb-2-rx {
					compatible = "qcom,msm-dai-q6-dev";
					phandle = <0x24>;
					qcom,msm-dai-q6-dev-id = <0x4004>;
				};

				qcom,msm-dai-q6-sb-2-tx {
					compatible = "qcom,msm-dai-q6-dev";
					phandle = <0x25>;
					qcom,msm-dai-q6-dev-id = <0x4005>;
				};

				qcom,msm-dai-q6-sb-3-rx {
					compatible = "qcom,msm-dai-q6-dev";
					phandle = <0x26>;
					qcom,msm-dai-q6-dev-id = <0x4006>;
				};

				qcom,msm-dai-q6-sb-3-tx {
					compatible = "qcom,msm-dai-q6-dev";
					phandle = <0x27>;
					qcom,msm-dai-q6-dev-id = <0x4007>;
				};

				qcom,msm-dai-q6-sb-4-rx {
					compatible = "qcom,msm-dai-q6-dev";
					phandle = <0x28>;
					qcom,msm-dai-q6-dev-id = <0x4008>;
				};

				qcom,msm-dai-q6-sb-4-tx {
					compatible = "qcom,msm-dai-q6-dev";
					phandle = <0x29>;
					qcom,msm-dai-q6-dev-id = <0x4009>;
				};

				qcom,msm-dai-q6-sb-5-rx {
					compatible = "qcom,msm-dai-q6-dev";
					phandle = <0x2a>;
					qcom,msm-dai-q6-dev-id = <0x400a>;
				};

				qcom,msm-dai-q6-sb-5-tx {
					compatible = "qcom,msm-dai-q6-dev";
					phandle = <0x2b>;
					qcom,msm-dai-q6-dev-id = <0x400b>;
				};

				qcom,msm-dai-q6-sb-6-rx {
					compatible = "qcom,msm-dai-q6-dev";
					phandle = <0x2c>;
					qcom,msm-dai-q6-dev-id = <0x400c>;
				};

				qcom,msm-dai-q6-sb-7-rx {
					compatible = "qcom,msm-dai-q6-dev";
					phandle = <0x2d>;
					qcom,msm-dai-q6-dev-id = <0x400e>;
				};

				qcom,msm-dai-q6-sb-7-tx {
					compatible = "qcom,msm-dai-q6-dev";
					phandle = <0x2e>;
					qcom,msm-dai-q6-dev-id = <0x400f>;
				};

				qcom,msm-dai-q6-sb-8-rx {
					compatible = "qcom,msm-dai-q6-dev";
					phandle = <0x2f>;
					qcom,msm-dai-q6-dev-id = <0x4010>;
				};

				qcom,msm-dai-q6-sb-8-tx {
					compatible = "qcom,msm-dai-q6-dev";
					phandle = <0x30>;
					qcom,msm-dai-q6-dev-id = <0x4011>;
				};

				qcom,msm-dai-q6-usb-audio-rx {
					compatible = "qcom,msm-dai-q6-dev";
					phandle = <0x39>;
					qcom,msm-dai-q6-dev-id = <0x7000>;
				};

				qcom,msm-dai-q6-usb-audio-tx {
					compatible = "qcom,msm-dai-q6-dev";
					phandle = <0x3a>;
					qcom,msm-dai-q6-dev-id = <0x7001>;
				};
			};

			qcom,msm-dai-q6-dp {
				compatible = "qcom,msm-dai-q6-hdmi";
				phandle = <0x15>;
				qcom,msm-dai-q6-dev-id = <0x6020>;
			};

			qcom,msm-dai-q6-hdmi {
				compatible = "qcom,msm-dai-q6-hdmi";
				phandle = <0x64>;
				qcom,msm-dai-q6-dev-id = <0x08>;
			};

			qcom,msm-dai-tdm-pri-rx {
				compatible = "qcom,msm-dai-tdm";
				qcom,msm-cpudai-tdm-clk-internal = <0x01>;
				qcom,msm-cpudai-tdm-clk-rate = <0x177000>;
				qcom,msm-cpudai-tdm-data-delay = <0x01>;
				qcom,msm-cpudai-tdm-data-out = <0x00>;
				qcom,msm-cpudai-tdm-group-id = <0x9100>;
				qcom,msm-cpudai-tdm-group-num-ports = <0x01>;
				qcom,msm-cpudai-tdm-group-port-id = <0x9000>;
				qcom,msm-cpudai-tdm-invert-sync = <0x01>;
				qcom,msm-cpudai-tdm-sync-mode = <0x01>;
				qcom,msm-cpudai-tdm-sync-src = <0x01>;

				qcom,msm-dai-q6-tdm-pri-rx-0 {
					compatible = "qcom,msm-dai-q6-tdm";
					phandle = <0x3b>;
					qcom,msm-cpudai-tdm-data-align = <0x00>;
					qcom,msm-cpudai-tdm-dev-id = <0x9000>;
				};
			};

			qcom,msm-dai-tdm-pri-tx {
				compatible = "qcom,msm-dai-tdm";
				qcom,msm-cpudai-tdm-clk-internal = <0x01>;
				qcom,msm-cpudai-tdm-clk-rate = <0x177000>;
				qcom,msm-cpudai-tdm-data-delay = <0x01>;
				qcom,msm-cpudai-tdm-data-out = <0x00>;
				qcom,msm-cpudai-tdm-group-id = <0x9101>;
				qcom,msm-cpudai-tdm-group-num-ports = <0x01>;
				qcom,msm-cpudai-tdm-group-port-id = <0x9001>;
				qcom,msm-cpudai-tdm-invert-sync = <0x01>;
				qcom,msm-cpudai-tdm-sync-mode = <0x01>;
				qcom,msm-cpudai-tdm-sync-src = <0x01>;

				qcom,msm-dai-q6-tdm-pri-tx-0 {
					compatible = "qcom,msm-dai-q6-tdm";
					phandle = <0x3c>;
					qcom,msm-cpudai-tdm-data-align = <0x00>;
					qcom,msm-cpudai-tdm-dev-id = <0x9001>;
				};
			};

			qcom,msm-dai-tdm-quat-rx {
				compatible = "qcom,msm-dai-tdm";
				phandle = <0x76>;
				qcom,msm-cpudai-tdm-clk-internal = <0x01>;
				qcom,msm-cpudai-tdm-clk-rate = <0x177000>;
				qcom,msm-cpudai-tdm-data-delay = <0x01>;
				qcom,msm-cpudai-tdm-data-out = <0x00>;
				qcom,msm-cpudai-tdm-group-id = <0x9130>;
				qcom,msm-cpudai-tdm-group-num-ports = <0x01>;
				qcom,msm-cpudai-tdm-group-port-id = <0x9030>;
				qcom,msm-cpudai-tdm-invert-sync = <0x01>;
				qcom,msm-cpudai-tdm-sync-mode = <0x01>;
				qcom,msm-cpudai-tdm-sync-src = <0x01>;

				qcom,msm-dai-q6-tdm-quat-rx-0 {
					compatible = "qcom,msm-dai-q6-tdm";
					phandle = <0x41>;
					qcom,msm-cpudai-tdm-data-align = <0x00>;
					qcom,msm-cpudai-tdm-dev-id = <0x9030>;
				};
			};

			qcom,msm-dai-tdm-quat-tx {
				compatible = "qcom,msm-dai-tdm";
				qcom,msm-cpudai-tdm-clk-internal = <0x01>;
				qcom,msm-cpudai-tdm-clk-rate = <0x177000>;
				qcom,msm-cpudai-tdm-data-delay = <0x01>;
				qcom,msm-cpudai-tdm-data-out = <0x00>;
				qcom,msm-cpudai-tdm-group-id = <0x9131>;
				qcom,msm-cpudai-tdm-group-num-ports = <0x01>;
				qcom,msm-cpudai-tdm-group-port-id = <0x9031>;
				qcom,msm-cpudai-tdm-invert-sync = <0x01>;
				qcom,msm-cpudai-tdm-sync-mode = <0x01>;
				qcom,msm-cpudai-tdm-sync-src = <0x01>;

				qcom,msm-dai-q6-tdm-quat-tx-0 {
					compatible = "qcom,msm-dai-q6-tdm";
					phandle = <0x42>;
					qcom,msm-cpudai-tdm-data-align = <0x00>;
					qcom,msm-cpudai-tdm-dev-id = <0x9031>;
				};
			};

			qcom,msm-dai-tdm-quin-rx {
				compatible = "qcom,msm-dai-tdm";
				qcom,msm-cpudai-tdm-clk-internal = <0x01>;
				qcom,msm-cpudai-tdm-clk-rate = <0x177000>;
				qcom,msm-cpudai-tdm-data-delay = <0x01>;
				qcom,msm-cpudai-tdm-data-out = <0x00>;
				qcom,msm-cpudai-tdm-group-id = <0x9140>;
				qcom,msm-cpudai-tdm-group-num-ports = <0x01>;
				qcom,msm-cpudai-tdm-group-port-id = <0x9040>;
				qcom,msm-cpudai-tdm-invert-sync = <0x01>;
				qcom,msm-cpudai-tdm-sync-mode = <0x01>;
				qcom,msm-cpudai-tdm-sync-src = <0x01>;

				qcom,msm-dai-q6-tdm-quin-rx-0 {
					compatible = "qcom,msm-dai-q6-tdm";
					phandle = <0x43>;
					qcom,msm-cpudai-tdm-data-align = <0x00>;
					qcom,msm-cpudai-tdm-dev-id = <0x9040>;
				};
			};

			qcom,msm-dai-tdm-quin-tx {
				compatible = "qcom,msm-dai-tdm";
				qcom,msm-cpudai-tdm-clk-internal = <0x01>;
				qcom,msm-cpudai-tdm-clk-rate = <0x177000>;
				qcom,msm-cpudai-tdm-data-delay = <0x01>;
				qcom,msm-cpudai-tdm-data-out = <0x00>;
				qcom,msm-cpudai-tdm-group-id = <0x9141>;
				qcom,msm-cpudai-tdm-group-num-ports = <0x01>;
				qcom,msm-cpudai-tdm-group-port-id = <0x9041>;
				qcom,msm-cpudai-tdm-invert-sync = <0x01>;
				qcom,msm-cpudai-tdm-sync-mode = <0x01>;
				qcom,msm-cpudai-tdm-sync-src = <0x01>;

				qcom,msm-dai-q6-tdm-quin-tx-0 {
					compatible = "qcom,msm-dai-q6-tdm";
					phandle = <0x44>;
					qcom,msm-cpudai-tdm-data-align = <0x00>;
					qcom,msm-cpudai-tdm-dev-id = <0x9041>;
				};
			};

			qcom,msm-dai-tdm-sec-rx {
				compatible = "qcom,msm-dai-tdm";
				qcom,msm-cpudai-tdm-clk-internal = <0x01>;
				qcom,msm-cpudai-tdm-clk-rate = <0x177000>;
				qcom,msm-cpudai-tdm-data-delay = <0x01>;
				qcom,msm-cpudai-tdm-data-out = <0x00>;
				qcom,msm-cpudai-tdm-group-id = <0x9110>;
				qcom,msm-cpudai-tdm-group-num-ports = <0x01>;
				qcom,msm-cpudai-tdm-group-port-id = <0x9010>;
				qcom,msm-cpudai-tdm-invert-sync = <0x01>;
				qcom,msm-cpudai-tdm-sync-mode = <0x01>;
				qcom,msm-cpudai-tdm-sync-src = <0x01>;

				qcom,msm-dai-q6-tdm-sec-rx-0 {
					compatible = "qcom,msm-dai-q6-tdm";
					phandle = <0x3d>;
					qcom,msm-cpudai-tdm-data-align = <0x00>;
					qcom,msm-cpudai-tdm-dev-id = <0x9010>;
				};
			};

			qcom,msm-dai-tdm-sec-tx {
				compatible = "qcom,msm-dai-tdm";
				qcom,msm-cpudai-tdm-clk-internal = <0x01>;
				qcom,msm-cpudai-tdm-clk-rate = <0x177000>;
				qcom,msm-cpudai-tdm-data-delay = <0x01>;
				qcom,msm-cpudai-tdm-data-out = <0x00>;
				qcom,msm-cpudai-tdm-group-id = <0x9111>;
				qcom,msm-cpudai-tdm-group-num-ports = <0x01>;
				qcom,msm-cpudai-tdm-group-port-id = <0x9011>;
				qcom,msm-cpudai-tdm-invert-sync = <0x01>;
				qcom,msm-cpudai-tdm-sync-mode = <0x01>;
				qcom,msm-cpudai-tdm-sync-src = <0x01>;

				qcom,msm-dai-q6-tdm-sec-tx-0 {
					compatible = "qcom,msm-dai-q6-tdm";
					phandle = <0x3e>;
					qcom,msm-cpudai-tdm-data-align = <0x00>;
					qcom,msm-cpudai-tdm-dev-id = <0x9011>;
				};
			};

			qcom,msm-dai-tdm-tert-rx {
				compatible = "qcom,msm-dai-tdm";
				qcom,msm-cpudai-tdm-clk-internal = <0x01>;
				qcom,msm-cpudai-tdm-clk-rate = <0x177000>;
				qcom,msm-cpudai-tdm-data-delay = <0x01>;
				qcom,msm-cpudai-tdm-data-out = <0x00>;
				qcom,msm-cpudai-tdm-group-id = <0x9120>;
				qcom,msm-cpudai-tdm-group-num-ports = <0x01>;
				qcom,msm-cpudai-tdm-group-port-id = <0x9020>;
				qcom,msm-cpudai-tdm-invert-sync = <0x01>;
				qcom,msm-cpudai-tdm-sync-mode = <0x01>;
				qcom,msm-cpudai-tdm-sync-src = <0x01>;

				qcom,msm-dai-q6-tdm-tert-rx-0 {
					compatible = "qcom,msm-dai-q6-tdm";
					phandle = <0x3f>;
					qcom,msm-cpudai-tdm-data-align = <0x00>;
					qcom,msm-cpudai-tdm-dev-id = <0x9020>;
				};
			};

			qcom,msm-dai-tdm-tert-tx {
				compatible = "qcom,msm-dai-tdm";
				qcom,msm-cpudai-tdm-clk-internal = <0x01>;
				qcom,msm-cpudai-tdm-clk-rate = <0x177000>;
				qcom,msm-cpudai-tdm-data-delay = <0x01>;
				qcom,msm-cpudai-tdm-data-out = <0x00>;
				qcom,msm-cpudai-tdm-group-id = <0x9121>;
				qcom,msm-cpudai-tdm-group-num-ports = <0x01>;
				qcom,msm-cpudai-tdm-group-port-id = <0x9021>;
				qcom,msm-cpudai-tdm-invert-sync = <0x01>;
				qcom,msm-cpudai-tdm-sync-mode = <0x01>;
				qcom,msm-cpudai-tdm-sync-src = <0x01>;

				qcom,msm-dai-q6-tdm-tert-tx-0 {
					compatible = "qcom,msm-dai-q6-tdm";
					phandle = <0x40>;
					qcom,msm-cpudai-tdm-data-align = <0x00>;
					qcom,msm-cpudai-tdm-dev-id = <0x9021>;
				};
			};

			qcom,msm-hdmi-dba-codec-rx {
				compatible = "qcom,msm-hdmi-dba-codec-rx";
				phandle = <0x74>;
				qcom,dba-bridge-chip = "adv7533";
			};

			qcom,msm-lsm-client {
				compatible = "qcom,msm-lsm-client";
				phandle = <0x11>;
			};

			qcom,msm-pcm {
				compatible = "qcom,msm-pcm-dsp";
				phandle = <0x08>;
				qcom,msm-pcm-dsp-id = <0x00>;
			};

			qcom,msm-pcm-afe {
				compatible = "qcom,msm-pcm-afe";
				phandle = <0x10>;
			};

			qcom,msm-pcm-dsp-noirq {
				compatible = "qcom,msm-pcm-dsp-noirq";
				phandle = <0x14>;
				qcom,latency-level = "ultra";
				qcom,msm-pcm-low-latency;
			};

			qcom,msm-pcm-hostless {
				compatible = "qcom,msm-pcm-hostless";
				phandle = <0x0f>;
			};

			qcom,msm-pcm-loopback {
				compatible = "qcom,msm-pcm-loopback";
				phandle = <0x0d>;
			};

			qcom,msm-pcm-low-latency {
				compatible = "qcom,msm-pcm-dsp";
				phandle = <0x09>;
				qcom,latency-level = "regular";
				qcom,msm-pcm-dsp-id = <0x01>;
				qcom,msm-pcm-low-latency;
			};

			qcom,msm-pcm-routing {
				compatible = "qcom,msm-pcm-routing";
				phandle = <0x12>;
			};

			qcom,msm-pcm-voice {
				compatible = "qcom,msm-pcm-voice";
				phandle = <0x0c>;
				qcom,destroy-cvd;
			};

			qcom,msm-pri-auxpcm {
				compatible = "qcom,msm-auxpcm-dev";
				phandle = <0x1b>;
				qcom,msm-auxpcm-interface = "primary";
				qcom,msm-cpudai-afe-clk-ver = <0x02>;
				qcom,msm-cpudai-auxpcm-data = <0x00 0x00>;
				qcom,msm-cpudai-auxpcm-frame = <0x05 0x04>;
				qcom,msm-cpudai-auxpcm-mode = <0x00 0x00>;
				qcom,msm-cpudai-auxpcm-num-slots = <0x01 0x01>;
				qcom,msm-cpudai-auxpcm-pcm-clk-rate = <0x1f4000 0x1f4000>;
				qcom,msm-cpudai-auxpcm-quant = <0x02 0x02>;
				qcom,msm-cpudai-auxpcm-slot-mapping = <0x01 0x01>;
				qcom,msm-cpudai-auxpcm-sync = <0x01 0x01>;
			};

			qcom,msm-quat-auxpcm {
				compatible = "qcom,msm-auxpcm-dev";
				phandle = <0x1e>;
				qcom,msm-auxpcm-interface = "quaternary";
				qcom,msm-cpudai-afe-clk-ver = <0x02>;
				qcom,msm-cpudai-auxpcm-data = <0x00 0x00>;
				qcom,msm-cpudai-auxpcm-frame = <0x05 0x04>;
				qcom,msm-cpudai-auxpcm-mode = <0x00 0x00>;
				qcom,msm-cpudai-auxpcm-num-slots = <0x01 0x01>;
				qcom,msm-cpudai-auxpcm-pcm-clk-rate = <0x1f4000 0x1f4000>;
				qcom,msm-cpudai-auxpcm-quant = <0x02 0x02>;
				qcom,msm-cpudai-auxpcm-slot-mapping = <0x01 0x01>;
				qcom,msm-cpudai-auxpcm-sync = <0x01 0x01>;
			};

			qcom,msm-quin-auxpcm {
				compatible = "qcom,msm-auxpcm-dev";
				phandle = <0x1f>;
				qcom,msm-auxpcm-interface = "quinary";
				qcom,msm-cpudai-afe-clk-ver = <0x02>;
				qcom,msm-cpudai-auxpcm-data = <0x00 0x00>;
				qcom,msm-cpudai-auxpcm-frame = <0x05 0x04>;
				qcom,msm-cpudai-auxpcm-mode = <0x00 0x00>;
				qcom,msm-cpudai-auxpcm-num-slots = <0x01 0x01>;
				qcom,msm-cpudai-auxpcm-pcm-clk-rate = <0x1f4000 0x1f4000>;
				qcom,msm-cpudai-auxpcm-quant = <0x02 0x02>;
				qcom,msm-cpudai-auxpcm-slot-mapping = <0x01 0x01>;
				qcom,msm-cpudai-auxpcm-sync = <0x01 0x01>;
			};

			qcom,msm-sec-auxpcm {
				compatible = "qcom,msm-auxpcm-dev";
				phandle = <0x1c>;
				qcom,msm-auxpcm-interface = "secondary";
				qcom,msm-cpudai-afe-clk-ver = <0x02>;
				qcom,msm-cpudai-auxpcm-data = <0x00 0x00>;
				qcom,msm-cpudai-auxpcm-frame = <0x05 0x04>;
				qcom,msm-cpudai-auxpcm-mode = <0x00 0x00>;
				qcom,msm-cpudai-auxpcm-num-slots = <0x01 0x01>;
				qcom,msm-cpudai-auxpcm-pcm-clk-rate = <0x1f4000 0x1f4000>;
				qcom,msm-cpudai-auxpcm-quant = <0x02 0x02>;
				qcom,msm-cpudai-auxpcm-slot-mapping = <0x01 0x01>;
				qcom,msm-cpudai-auxpcm-sync = <0x01 0x01>;
			};

			qcom,msm-stub-codec {
				compatible = "qcom,msm-stub-codec";
				phandle = <0x47>;
			};

			qcom,msm-tert-auxpcm {
				compatible = "qcom,msm-auxpcm-dev";
				phandle = <0x1d>;
				qcom,msm-auxpcm-interface = "tertiary";
				qcom,msm-cpudai-afe-clk-ver = <0x02>;
				qcom,msm-cpudai-auxpcm-data = <0x00 0x00>;
				qcom,msm-cpudai-auxpcm-frame = <0x05 0x04>;
				qcom,msm-cpudai-auxpcm-mode = <0x00 0x00>;
				qcom,msm-cpudai-auxpcm-num-slots = <0x01 0x01>;
				qcom,msm-cpudai-auxpcm-pcm-clk-rate = <0x1f4000 0x1f4000>;
				qcom,msm-cpudai-auxpcm-quant = <0x02 0x02>;
				qcom,msm-cpudai-auxpcm-slot-mapping = <0x01 0x01>;
				qcom,msm-cpudai-auxpcm-sync = <0x01 0x01>;
			};

			qcom,msm-ultra-low-latency {
				compatible = "qcom,msm-pcm-dsp";
				phandle = <0x0a>;
				qcom,latency-level = "ultra";
				qcom,msm-pcm-dsp-id = <0x02>;
				qcom,msm-pcm-low-latency;
			};

			qcom,msm-voip-dsp {
				compatible = "qcom,msm-voip-dsp";
				phandle = <0x0b>;
			};
		};
	};

	fragment@17 {
		target = <0xffffffff>;

		__overlay__ {

			qcom,avtimer@62cf700c {
				compatible = "qcom,avtimer";
				qcom,clk-div = <0xc0>;
				qcom,clk-mult = <0x0a>;
				reg = <0x62cf700c 0x04 0x62cf7010 0x04>;
				reg-names = "avtimer_lsb_addr\0avtimer_msb_addr";
			};

			qcom,msm-audio-apr {
				compatible = "qcom,msm-audio-apr";

				msm_audio_apr_dummy {
					compatible = "qcom,msm-audio-apr-dummy";
				};
			};

			sound-tavil {
				asoc-codec = <0x47 0xffffffff>;
				asoc-codec-names = "msm-stub-codec.1\0msm-ext-disp-audio-codec-rx";
				asoc-cpu = <0x15 0x16 0x17 0x18 0x19 0x1a 0x1b 0x1c 0x1d 0x1e 0x1f 0x20 0x21 0x22 0x23 0x24 0x25 0x26 0x27 0x28 0x29 0x2a 0x2b 0x2c 0x2d 0x2e 0x2f 0x30 0x31 0x32 0x33 0x34 0x35 0x36 0x37 0x38 0x39 0x3a 0x3b 0x3c 0x3d 0x3e 0x3f 0x40 0x41 0x42 0x43 0x44>;
				asoc-cpu-names = "msm-dai-q6-dp.24608\0msm-dai-q6-mi2s.0\0msm-dai-q6-mi2s.1\0msm-dai-q6-mi2s.2\0msm-dai-q6-mi2s.3\0msm-dai-q6-mi2s.4\0msm-dai-q6-auxpcm.1\0msm-dai-q6-auxpcm.2\0msm-dai-q6-auxpcm.3\0msm-dai-q6-auxpcm.4\0msm-dai-q6-auxpcm.5\0msm-dai-q6-dev.16384\0msm-dai-q6-dev.16385\0msm-dai-q6-dev.16386\0msm-dai-q6-dev.16387\0msm-dai-q6-dev.16388\0msm-dai-q6-dev.16389\0msm-dai-q6-dev.16390\0msm-dai-q6-dev.16391\0msm-dai-q6-dev.16392\0msm-dai-q6-dev.16393\0msm-dai-q6-dev.16394\0msm-dai-q6-dev.16395\0msm-dai-q6-dev.16396\0msm-dai-q6-dev.16398\0msm-dai-q6-dev.16399\0msm-dai-q6-dev.16400\0msm-dai-q6-dev.16401\0msm-dai-q6-dev.224\0msm-dai-q6-dev.225\0msm-dai-q6-dev.241\0msm-dai-q6-dev.240\0msm-dai-q6-dev.32771\0msm-dai-q6-dev.32772\0msm-dai-q6-dev.32773\0msm-dai-q6-dev.32770\0msm-dai-q6-dev.28672\0msm-dai-q6-dev.28673\0msm-dai-q6-tdm.36864\0msm-dai-q6-tdm.36865\0msm-dai-q6-tdm.36880\0msm-dai-q6-tdm.36881\0msm-dai-q6-tdm.36896\0msm-dai-q6-tdm.36897\0msm-dai-q6-tdm.36912\0msm-dai-q6-tdm.36913\0msm-dai-q6-tdm.36928\0msm-dai-q6-tdm.36929";
				asoc-platform = <0x08 0x09 0x0a 0x0b 0x0c 0x0d 0x0e 0x0f 0x10 0x11 0x12 0xffffffff 0x13 0x14>;
				asoc-platform-names = "msm-pcm-dsp.0\0msm-pcm-dsp.1\0msm-pcm-dsp.2\0msm-voip-dsp\0msm-pcm-voice\0msm-pcm-loopback\0msm-compress-dsp\0msm-pcm-hostless\0msm-pcm-afe\0msm-lsm-client\0msm-pcm-routing\0msm-cpe-lsm\0msm-compr-dsp\0msm-pcm-dsp-noirq";
				compatible = "qcom,sdm670-asoc-snd-tavil";
				phandle = <0x77>;
				qcom,audio-routing = "AIF4 VI\0MCLK\0RX_BIAS\0MCLK\0MADINPUT\0MCLK\0hifi amp\0LINEOUT1\0hifi amp\0LINEOUT2\0AMIC2\0MIC BIAS2\0MIC BIAS2\0Headset Mic\0AMIC3\0MIC BIAS2\0MIC BIAS2\0ANCRight Headset Mic\0AMIC4\0MIC BIAS2\0MIC BIAS2\0ANCLeft Headset Mic\0AMIC5\0MIC BIAS3\0MIC BIAS3\0Handset Mic\0DMIC0\0MIC BIAS1\0MIC BIAS1\0Digital Mic0\0DMIC1\0MIC BIAS1\0MIC BIAS1\0Digital Mic1\0DMIC2\0MIC BIAS3\0MIC BIAS3\0Digital Mic2\0DMIC3\0MIC BIAS3\0MIC BIAS3\0Digital Mic3\0DMIC4\0MIC BIAS4\0MIC BIAS4\0Digital Mic4\0DMIC5\0MIC BIAS4\0MIC BIAS4\0Digital Mic5\0SpkrLeft IN\0SPK1 OUT\0SpkrRight IN\0SPK2 OUT";
				qcom,auxpcm-audio-intf;
				qcom,ext-disp-audio-rx;
				qcom,hph-en0-gpio = <0x45>;
				qcom,hph-en1-gpio = <0x46>;
				qcom,mi2s-audio-intf;
				qcom,model = "sdm670-tavil-snd-card";
				qcom,msm-mbhc-gnd-swh = <0x01>;
				qcom,msm-mbhc-hphl-swh = <0x01>;
				qcom,msm-mclk-freq = <0x927c00>;
				qcom,msm-mi2s-master = <0x01 0x01 0x01 0x01 0x01>;
				qcom,wcn-btfm;
				qcom,wsa-aux-dev-prefix = "SpkrLeft\0SpkrRight\0SpkrLeft\0SpkrRight";
				qcom,wsa-devs = <0x48 0x49 0x4a 0x4b>;
				qcom,wsa-max-devs = <0x02>;
				status = "okay";
			};
		};
	};

	fragment@18 {
		target = <0xffffffff>;

		__overlay__ {
			status = "okay";

			msm_dai_slim {
				compatible = "qcom,msm-dai-slim";
				elemental-addr = [ff ff ff fe 17 02];
				phandle = <0x78>;
				status = "okay";
			};
		};
	};

	fragment@19 {
		target = <0xffffffff>;

		__overlay__ {

			tasha_codec {

				msm_cdc_pinctrll {
					compatible = "qcom,msm-cdc-pinctrl";
					phandle = <0x58>;
					pinctrl-0 = <0xffffffff>;
					pinctrl-1 = <0xffffffff>;
					pinctrl-names = "aud_active\0aud_sleep";
				};

				msm_cdc_pinctrlr {
					compatible = "qcom,msm-cdc-pinctrl";
					phandle = <0x59>;
					pinctrl-0 = <0xffffffff>;
					pinctrl-1 = <0xffffffff>;
					pinctrl-names = "aud_active\0aud_sleep";
				};
			};

			tavil_codec {

				msm_cdc_pinctrl_hph_en0 {
					compatible = "qcom,msm-cdc-pinctrl";
					phandle = <0x45>;
					pinctrl-0 = <0x52>;
					pinctrl-1 = <0x53>;
					pinctrl-names = "aud_active\0aud_sleep";
				};

				msm_cdc_pinctrl_hph_en1 {
					compatible = "qcom,msm-cdc-pinctrl";
					phandle = <0x46>;
					pinctrl-0 = <0x54>;
					pinctrl-1 = <0x55>;
					pinctrl-names = "aud_active\0aud_sleep";
				};

				msm_cdc_pinctrl_us_euro_sw {
					compatible = "qcom,msm-cdc-pinctrl";
					phandle = <0x7a>;
					pinctrl-0 = <0x50>;
					pinctrl-1 = <0x51>;
					pinctrl-names = "aud_active\0aud_sleep";
				};

				msm_cdc_pinctrll {
					compatible = "qcom,msm-cdc-pinctrl";
					phandle = <0x56>;
					pinctrl-0 = <0x4c>;
					pinctrl-1 = <0x4d>;
					pinctrl-names = "aud_active\0aud_sleep";
				};

				msm_cdc_pinctrlr {
					compatible = "qcom,msm-cdc-pinctrl";
					phandle = <0x57>;
					pinctrl-0 = <0x4e>;
					pinctrl-1 = <0x4f>;
					pinctrl-names = "aud_active\0aud_sleep";
				};

				wcd_pinctrl@5 {
					#gpio-cells = <0x02>;
					compatible = "qcom,wcd-pinctrl";
					gpio-controller;
					phandle = <0x79>;
					qcom,num-gpios = <0x05>;

					hph_en0_wcd_active {
						phandle = <0x52>;

						config {
							output-high;
							pins = "gpio4";
						};

						mux {
							pins = "gpio4";
						};
					};

					hph_en0_wcd_sleep {
						phandle = <0x53>;

						config {
							output-low;
							pins = "gpio4";
						};

						mux {
							pins = "gpio4";
						};
					};

					hph_en1_wcd_active {
						phandle = <0x54>;

						config {
							output-high;
							pins = "gpio5";
						};

						mux {
							pins = "gpio5";
						};
					};

					hph_en1_wcd_sleep {
						phandle = <0x55>;

						config {
							output-low;
							pins = "gpio5";
						};

						mux {
							pins = "gpio5";
						};
					};

					spkr_1_wcd_en_active {
						phandle = <0x4c>;

						config {
							output-high;
							pins = "gpio2";
						};

						mux {
							pins = "gpio2";
						};
					};

					spkr_1_wcd_en_sleep {
						phandle = <0x4d>;

						config {
							input-enable;
							pins = "gpio2";
						};

						mux {
							pins = "gpio2";
						};
					};

					spkr_2_sd_n_active {
						phandle = <0x4e>;

						config {
							output-high;
							pins = "gpio3";
						};

						mux {
							pins = "gpio3";
						};
					};

					spkr_2_sd_n_sleep {
						phandle = <0x4f>;

						config {
							input-enable;
							pins = "gpio3";
						};

						mux {
							pins = "gpio3";
						};
					};

					us_euro_sw_wcd_active {
						phandle = <0x50>;

						config {
							output-high;
							pins = "gpio1";
						};

						mux {
							pins = "gpio1";
						};
					};

					us_euro_sw_wcd_sleep {
						phandle = <0x51>;

						config {
							output-low;
							pins = "gpio1";
						};

						mux {
							pins = "gpio1";
						};
					};
				};
			};
		};
	};

	fragment@2 {
		target = <0xffffffff>;

		__overlay__ {
			vbus-supply = <0x02>;
			vconn-supply = <0x03>;
			vdd-pdphy-supply = <0xffffffff>;
		};
	};

	fragment@20 {
		target = <0xffffffff>;

		__overlay__ {

			tasha_codec {

				swr_master {
					#address-cells = <0x02>;
					#size-cells = <0x00>;
					compatible = "qcom,swr-wcd";

					wsa881x@20170211 {
						compatible = "qcom,wsa881x";
						phandle = <0x7b>;
						qcom,spkr-sd-n-node = <0x58>;
						reg = <0x00 0x20170211>;
					};

					wsa881x@20170212 {
						compatible = "qcom,wsa881x";
						phandle = <0x7c>;
						qcom,spkr-sd-n-node = <0x59>;
						reg = <0x00 0x20170212>;
					};

					wsa881x@21170213 {
						compatible = "qcom,wsa881x";
						phandle = <0x7d>;
						qcom,spkr-sd-n-node = <0x58>;
						reg = <0x00 0x21170213>;
					};

					wsa881x@21170214 {
						compatible = "qcom,wsa881x";
						phandle = <0x7e>;
						qcom,spkr-sd-n-node = <0x59>;
						reg = <0x00 0x21170214>;
					};
				};
			};

			tavil_codec {

				swr_master {
					#address-cells = <0x02>;
					#size-cells = <0x00>;
					compatible = "qcom,swr-wcd";

					wsa881x@20170211 {
						compatible = "qcom,wsa881x";
						phandle = <0x48>;
						qcom,spkr-sd-n-node = <0x56>;
						reg = <0x00 0x20170211>;
					};

					wsa881x@20170212 {
						compatible = "qcom,wsa881x";
						phandle = <0x49>;
						qcom,spkr-sd-n-node = <0x57>;
						reg = <0x00 0x20170212>;
					};

					wsa881x@21170213 {
						compatible = "qcom,wsa881x";
						phandle = <0x4a>;
						qcom,spkr-sd-n-node = <0x56>;
						reg = <0x00 0x21170213>;
					};

					wsa881x@21170214 {
						compatible = "qcom,wsa881x";
						phandle = <0x4b>;
						qcom,spkr-sd-n-node = <0x57>;
						reg = <0x00 0x21170214>;
					};
				};
			};
		};
	};

	fragment@21 {
		target = <0xffffffff>;

		__overlay__ {

			lpi_pinctrl@62b40000 {
				#gpio-cells = <0x02>;
				compatible = "qcom,lpi-pinctrl";
				gpio-controller;
				phandle = <0x7f>;
				qcom,num-gpios = <0x20>;
				reg = <0x62b40000 0x00>;

				cdc_pdm_2_gpios_active {
					phandle = <0x8a>;

					config {
						drive-strength = <0x08>;
						pins = "gpio20";
					};

					mux {
						function = "func2";
						pins = "gpio20";
					};
				};

				cdc_pdm_2_gpios_sleep {
					phandle = <0x8b>;

					config {
						bias-disable;
						drive-strength = <0x02>;
						pins = "gpio20";
					};

					mux {
						function = "func2";
						pins = "gpio20";
					};
				};

				cdc_pdm_clk_active {
					phandle = <0x82>;

					config {
						drive-strength = <0x04>;
						output-low;
						pins = "gpio18";
					};

					mux {
						function = "func2";
						pins = "gpio18";
					};
				};

				cdc_pdm_clk_sleep {
					phandle = <0x83>;

					config {
						bias-disable;
						drive-strength = <0x02>;
						output-low;
						pins = "gpio18";
					};

					mux {
						function = "func2";
						pins = "gpio18";
					};
				};

				cdc_pdm_rx0_active {
					phandle = <0x86>;

					config {
						drive-strength = <0x04>;
						output-low;
						pins = "gpio21";
					};

					mux {
						function = "func2";
						pins = "gpio21";
					};
				};

				cdc_pdm_rx0_comp_active {
					phandle = <0x8c>;

					config {
						drive-strength = <0x04>;
						pins = "gpio22";
					};

					mux {
						function = "func2";
						pins = "gpio22";
					};
				};

				cdc_pdm_rx0_comp_sleep {
					phandle = <0x8d>;

					config {
						bias-disable;
						drive-strength = <0x02>;
						pins = "gpio22";
					};

					mux {
						function = "func2";
						pins = "gpio22";
					};
				};

				cdc_pdm_rx0_sleep {
					phandle = <0x87>;

					config {
						bias-disable;
						drive-strength = <0x02>;
						output-low;
						pins = "gpio21";
					};

					mux {
						function = "func2";
						pins = "gpio21";
					};
				};

				cdc_pdm_rx1_2_active {
					phandle = <0x88>;

					config {
						drive-strength = <0x04>;
						output-low;
						pins = "gpio23\0gpio25";
					};

					mux {
						function = "func1";
						pins = "gpio23\0gpio25";
					};
				};

				cdc_pdm_rx1_2_sleep {
					phandle = <0x89>;

					config {
						bias-disable;
						drive-strength = <0x02>;
						output-low;
						pins = "gpio23\0gpio25";
					};

					mux {
						function = "func1";
						pins = "gpio23\0gpio25";
					};
				};

				cdc_pdm_rx1_comp_active {
					phandle = <0x8e>;

					config {
						drive-strength = <0x04>;
						pins = "gpio24";
					};

					mux {
						function = "func1";
						pins = "gpio24";
					};
				};

				cdc_pdm_rx1_comp_sleep {
					phandle = <0x8f>;

					config {
						bias-disable;
						drive-strength = <0x02>;
						pins = "gpio24";
					};

					mux {
						function = "func1";
						pins = "gpio24";
					};
				};

				cdc_pdm_sync_active {
					phandle = <0x84>;

					config {
						drive-strength = <0x04>;
						output-low;
						pins = "gpio19";
					};

					mux {
						function = "func3";
						pins = "gpio19";
					};
				};

				cdc_pdm_sync_sleep {
					phandle = <0x85>;

					config {
						bias-disable;
						drive-strength = <0x02>;
						output-low;
						pins = "gpio19";
					};

					mux {
						function = "func3";
						pins = "gpio19";
					};
				};

				dmic12_gpios_active {
					phandle = <0x90>;

					config {
						drive-strength = <0x08>;
						output-high;
						pins = "gpio26\0gpio28";
					};

					mux {
						function = "func1";
						pins = "gpio26\0gpio28";
					};
				};

				dmic12_gpios_sleep {
					phandle = <0x91>;

					config {
						bias-disable;
						drive-strength = <0x02>;
						output-low;
						pins = "gpio26\0gpio28";
					};

					mux {
						function = "func1";
						pins = "gpio26\0gpio28";
					};
				};

				dmic34_gpios_active {
					phandle = <0x92>;

					config {
						drive-strength = <0x08>;
						input-enable;
						pins = "gpio27\0gpio29";
					};

					mux {
						function = "func1";
						pins = "gpio27\0gpio29";
					};
				};

				dmic34_gpios_sleep {
					phandle = <0x93>;

					config {
						drive-strength = <0x02>;
						input-enable;
						pins = "gpio27\0gpio29";
						pull-down;
					};

					mux {
						function = "func1";
						pins = "gpio27\0gpio29";
					};
				};

				lpi_cdc_reset_active {
					phandle = <0x5a>;

					config {
						drive-strength = <0x10>;
						output-high;
						pins = "gpio29";
					};

					mux {
						function = "func2";
						pins = "gpio29";
					};
				};

				lpi_cdc_reset_sleep {
					phandle = <0x5b>;

					config {
						bias-disable;
						drive-strength = <0x10>;
						output-low;
						pins = "gpio29";
					};

					mux {
						function = "func2";
						pins = "gpio29";
					};
				};

				lpi_mclk0_active {
					phandle = <0x80>;

					config {
						bias-disable;
						drive-strength = <0x08>;
						output-low;
						pins = "gpio19";
					};

					mux {
						function = "func1";
						pins = "gpio19";
					};
				};

				lpi_mclk0_sleep {
					phandle = <0x81>;

					config {
						bias-disable;
						bias-pull-down;
						drive-strength = <0x02>;
						pins = "gpio19";
					};

					mux {
						function = "func1";
						pins = "gpio19";
					};
				};
			};
		};
	};

	fragment@22 {
		target = <0xffffffff>;

		__overlay__ {
			status = "okay";
		};
	};

	fragment@23 {
		target = <0xffffffff>;

		__overlay__ {

			audio_ext_clk_lnbb {
				#clock-cells = <0x01>;
				clock-names = "osr_clk";
				clocks = <0xffffffff 0x02>;
				compatible = "qcom,audio-ref-clk";
				phandle = <0x60>;
				qcom,node_has_rpm_clock;
				status = "okay";
			};

			msm_cdc_pinctrl@126 {
				compatible = "qcom,msm-cdc-pinctrl";
				phandle = <0x61>;
				pinctrl-0 = <0xffffffff>;
				pinctrl-1 = <0xffffffff>;
				pinctrl-names = "aud_active\0aud_sleep";
				status = "okay";
			};

			msm_cdc_pinctrl@64 {
				compatible = "qcom,msm-cdc-pinctrl";
				phandle = <0x5f>;
				pinctrl-0 = <0x5a>;
				pinctrl-1 = <0x5b>;
				pinctrl-names = "aud_active\0aud_sleep";
				qcom,lpi-gpios;
				status = "okay";
			};

			msm_cdc_pinctrl_usbc_audio_en1 {
				compatible = "qcom,msm-cdc-pinctrl";
				phandle = <0x94>;
				pinctrl-0 = <0xffffffff>;
				pinctrl-1 = <0xffffffff>;
				pinctrl-names = "aud_active\0aud_sleep";
			};

			qcom,wcd-dsp-glink {
				compatible = "qcom,wcd-dsp-glink";
				phandle = <0x96>;
				status = "okay";
			};

			qcom,wcd-dsp-mgr {
				compatible = "qcom,wcd-dsp-mgr";
				phandle = <0x95>;
				qcom,img-filename = "cpe_9340";
				qcom,wdsp-components = <0x5c 0x00 0x5d 0x01 0xffffffff 0x02>;
				status = "okay";
			};

			wcd9xxx-irq {
				#interrupt-cells = <0x01>;
				compatible = "qcom,wcd9xxx-irq";
				interrupt-controller;
				interrupt-parent = <0xffffffff>;
				phandle = <0x5e>;
				pinctrl-0 = <0xffffffff>;
				pinctrl-names = "default";
				qcom,gpio-connect = <0xffffffff 0x50 0x00>;
				status = "okay";
			};
		};
	};

	fragment@24 {
		target = <0xffffffff>;

		__overlay__ {

			tavil_codec {
				cdc-vdd-mic-bias-supply = <0xffffffff>;
				clock-names = "wcd_clk";
				clocks = <0x60 0x00>;
				compatible = "qcom,tavil-slim-pgd";
				elemental-addr = [00 01 50 02 17 02];
				interrupt-parent = <0x5e>;
				interrupts = <0x00 0x01 0x02 0x03 0x04 0x05 0x06 0x07 0x08 0x09 0x0a 0x0b 0x0c 0x0d 0x0e 0x0f 0x10 0x11 0x12 0x13 0x14 0x15 0x16 0x17 0x18 0x19 0x1a 0x1b 0x1c 0x1d 0x1e 0x1f>;
				phandle = <0x5c>;
				qcom,cdc-dmic-sample-rate = "\0I>";
				qcom,cdc-mad-dmic-rate = <0x927c0>;
				qcom,cdc-mclk-clk-rate = <0x927c00>;
				qcom,cdc-micbias1-mv = <0x708>;
				qcom,cdc-micbias2-mv = <0x708>;
				qcom,cdc-micbias3-mv = <0x708>;
				qcom,cdc-micbias4-mv = <0x708>;
				qcom,cdc-slim-ifd = "tavil-slim-ifd";
				qcom,cdc-slim-ifd-elemental-addr = [00 00 50 02 17 02];
				qcom,cdc-static-supplies = "cdc-vdd-mic-bias";
				qcom,cdc-vdd-mic-bias-current = <0x76c0>;
				qcom,cdc-vdd-mic-bias-voltage = <0x19e100 0x1d0d80>;
				qcom,has-micbias-supply-en-gpio;
				qcom,micbias-supply-en-gpio-node = <0x61>;
				qcom,wcd-rst-gpio-node = <0x5f>;
				qcom,wdsp-cmpnt-dev-name = "tavil_codec";
				status = "okay";

				wcd_spi {
					compatible = "qcom,wcd-spi-v2";
					phandle = <0x5d>;
					qcom,chip-select = <0x00>;
					qcom,master-bus-num = <0x00>;
					qcom,max-frequency = <0x16e3600>;
					qcom,mem-base-addr = <0x100000>;
				};
			};
		};
	};

	fragment@25 {
		target = <0xffffffff>;

		__overlay__ {
			status = "disabled";
		};
	};

	fragment@3 {
		target = <0xffffffff>;

		__overlay__ {
			extcon = <0xffffffff 0xffffffff 0xffffffff 0x04 0x04>;
			vbus_dwc3-supply = <0x02>;
		};
	};

	fragment@4 {
		target = <0xffffffff>;

		__overlay__ {

			qcom,camera-ir-led@0 {
				cell-index = <0x00>;
				compatible = "qcom,camera-ir-led";
				enable-active-high;
				gpio-no-mux = <0x00>;
				gpio-req-tbl-flags = <0x00 0x00 0x00 0x00 0x00>;
				gpio-req-tbl-label = "CAM_IR_LED\0CAM_IR_LED_CUR0\0CAM_IR_LED_CUR1\0CAM_IR_CUT1\0CAM_IR_CUT2";
				gpio-req-tbl-num = <0x00 0x01 0x02 0x03 0x04>;
				gpios = <0xffffffff 0x16 0x00 0xffffffff 0x8d 0x00 0xffffffff 0x8e 0x00 0xffffffff 0x6b 0x00 0xffffffff 0x6e 0x00>;
				phandle = <0x05>;
				pinctrl-0 = <0xffffffff>;
				pinctrl-1 = <0xffffffff>;
				pinctrl-names = "cam_default\0cam_suspend";
				reg = <0x00>;
				status = "ok";
			};
		};
	};

	fragment@5 {
		target = <0xffffffff>;

		__overlay__ {

			qcom,cam-res-mgr {
				compatible = "qcom,cam-res-mgr";
				status = "ok";
			};

			qcom,cam-sensor@0 {
				cam_clk-supply = <0xffffffff>;
				cam_vana-supply = <0xffffffff>;
				cam_vdig-supply = <0xffffffff>;
				cam_vio-supply = <0xffffffff>;
				cci-master = <0x00>;
				cell-index = <0x00>;
				clock-cntl-level = "turbo";
				clock-names = "cam_clk";
				clock-rates = <0x16e3600>;
				clocks = <0xffffffff 0x42>;
				compatible = "qcom,cam-sensor";
				csiphy-sd-index = <0x00>;
				gpio-no-mux = <0x00>;
				gpio-req-tbl-flags = <0x01 0x00>;
				gpio-req-tbl-label = "CAMIF_MCLK0\0CAM_RESET0";
				gpio-req-tbl-num = <0x00 0x01>;
				gpio-reset = <0x01>;
				gpios = <0xffffffff 0x0d 0x00 0xffffffff 0x1e 0x00>;
				ir-led-src = <0x05>;
				pinctrl-0 = <0xffffffff 0xffffffff>;
				pinctrl-1 = <0xffffffff 0xffffffff>;
				pinctrl-names = "cam_default\0cam_suspend";
				reg = <0x00>;
				regulator-names = "cam_vio\0cam_vana\0cam_vdig\0cam_clk";
				rgltr-cntrl-support;
				rgltr-load-current = <0x00 0x13880 0x19a28 0x00>;
				rgltr-max-voltage = <0x1b7740 0x2c4020 0x124f80 0x00>;
				rgltr-min-voltage = <0x1b7740 0x2c4020 0x124f80 0x00>;
				sensor-mode = <0x00>;
				sensor-position-pitch = <0x00>;
				sensor-position-roll = <0x10e>;
				sensor-position-yaw = <0xb4>;
				status = "ok";
			};
		};
	};

	fragment@6 {
		target = <0xffffffff>;

		__overlay__ {
			status = "disabled";
		};
	};

	fragment@7 {
		target = <0xffffffff>;

		__overlay__ {
			status = "ok";
		};
	};

	fragment@8 {
		target = <0xffffffff>;

		__overlay__ {
			status = "disabled";
		};
	};

	fragment@9 {
		target = <0xffffffff>;

		__overlay__ {
			pinctrl-0 = <0xffffffff 0xffffffff 0xffffffff 0xffffffff>;
			pinctrl-1 = <0xffffffff 0xffffffff 0xffffffff 0xffffffff>;
			pinctrl-names = "active\0sleep";
			qcom,vdd-current-level = <0x00 0x8b290>;
			qcom,vdd-io-always-on;
			qcom,vdd-io-current-level = <0x00 0x4f588>;
			qcom,vdd-io-lpm-sup;
			qcom,vdd-io-voltage-level = <0x1b7740 0x1b7740>;
			qcom,vdd-voltage-level = <0x2d2a80 0x2d2a80>;
			status = "ok";
			vdd-io-supply = <0xffffffff>;
			vdd-supply = <0xffffffff>;
		};
	};
};
